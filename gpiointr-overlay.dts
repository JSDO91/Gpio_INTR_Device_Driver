/dts-v1/;

/plugin/;

/ {
        compatible = "brcm,bcm2711";

        fragment@0{

                target-path = "/";

                __overlay__

                {
                        gpio_intr: gpio_intr
                        {
                                compatible = "jaesun,gpio_intr";
                                pinctrl-names = "default";
                                pinctrl-0 = <&intr_gpio17>;
                                gpios = <&gpio 17 0>;
                                status = "okay";
                        };

                };

        }; 

        fragment@1{

                target = <&gpio>;

                __overlay__

                {

                        intr_gpio17: intr_gpio17
                        {
                                brcm,pins = <17>;
                                brcm,function = <0>;
                                brcm,pull = <2>;
                        };

                };

        };

};